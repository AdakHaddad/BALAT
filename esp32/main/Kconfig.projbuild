## esp32/main/Kconfig.projbuild
```kconfig
menu "BALAT PCB demo"

config BALAT_GNSS_RX_GPIO
    int "GNSS UART RX GPIO"
    default 20
config BALAT_GNSS_TX_GPIO
    int "GNSS UART TX GPIO (unused on PCB)"
    default -1
config BALAT_GPS_ENABLE_GPIO
    int "GPS power switch GPIO (active low)"
    default 5
config BALAT_BUZZER_GPIO
    int "PCB buzzer-driver control GPIO"
    default 3
config BALAT_MOTOR_GPIO
    int "PCB motor-driver control GPIO"
    default 4
config BALAT_STATUS_LED_GPIO
    int "Green status LED GPIO"
    default 10
config BALAT_LED_RED_GPIO
    int "Red status LED GPIO (unused on PCB)"
    default 7
config BALAT_LED_YELLOW_GPIO
    int "Yellow status LED GPIO (unused on PCB)"
    default 21
config BALAT_CUE_ENABLE_GPIO
    int "PCB button used as hold-to-enable (active low)"
    default 6

endmenu
```

## esp32/sdkconfig.defaults
```kconfig
CONFIG_IDF_TARGET="esp32c3"
CONFIG_FREERTOS_HZ=1000
CONFIG_ESP_TASK_WDT_INIT=y
CONFIG_ESP_TASK_WDT_TIMEOUT_S=5
CONFIG_ESP_TASK_WDT_PANIC=y
CONFIG_LOG_DEFAULT_LEVEL_INFO=y
```
